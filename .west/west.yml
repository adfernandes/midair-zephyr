## .west/west.yml
```yaml
# This project is set up with Git submodules.
# We are NOT using West for anything but additional commands.
# https://docs.zephyrproject.org/latest/guides/west/without-west.html
#
# This file is provided as a sample reference only!

manifest:

  self:

    path: west

  defaults:

    remote: zephyr

  remotes:

    - name: zephyr
      url-base: git@github.com:zephyrproject-rtos

  projects:

    - name: zephyr
      revision: master
      west-commands: scripts/west-commands.yml
      path: rtos/zephyr

    - name: cmsis
      revision: master
      path: rtos/modules/hal/cmsis

    - name: hal_nordic
      revision: master
      path: rtos/modules/hal/nordic

    - name: hal_st
      revision: master
      path: rtos/modules/hal/stmemsc

    - name: libmetal
      revision: master
      path: rtos/modules/hal/libmetal

    - name: mcuboot
      revision: master
      path: rtos/boot/mcuboot

    - name: segger
      revision: master
      path: rtos/modules/debug/segger

    - name: tinycbor
      path: rtos/modules/lib/tinycbor
      revision: master

    - name: tinycrypt
      path: rtos/modules/lib/tinycrypt
      revision: master

    - name: nrf_hw_models
      path: rtos/modules/bsim
      revision: master
```

## boards/arm/nrf52832_midair/Kconfig
```kconfig
# Kconfig - nrf52832-midair board configuration
#
# Copyright (c) 2019 Andrew Fernandes <andrew@fernandes.org>
#
# SPDX-License-Identifier: Apache-2.0
#

if BOARD_NRF52832_MIDAIR

config BOARD_ENABLE_DCDC
	bool "Enable DCDC mode"
	select SOC_DCDC_NRF52X
	default y

endif # BOARD_NRF52832_MIDAIR
```

## boards/arm/nrf52832_midair/Kconfig.board
```kconfig
# Kconfig - nrf52832-midair board configuration
#
# Copyright (c) 2019 Andrew Fernandes <andrew@fernandes.org>
#
# SPDX-License-Identifier: Apache-2.0
#

config  BOARD_NRF52832_MIDAIR
	bool "nRF52832-MIDAIR"
	depends on SOC_NRF52832_CIAA
```

## boards/arm/nrf52832_midair/Kconfig.defconfig
```kconfig
# Kconfig - nrf52832-midair board configuration
#
# Copyright (c) 2019 Andrew Fernandes <andrew@fernandes.org>
#
# SPDX-License-Identifier: Apache-2.0
#

if BOARD_NRF52832_MIDAIR

config BOARD
	default "nrf52832_midair"

config HAS_STMEMSC
       default y

config USE_STDC_LSM6DSOX
       default y

endif # BOARD_NRF52832_MIDAIR
```

## boards/arm/nrf52832_midair/nrf52832_midair_defconfig
```kconfig
#
# Copyright (c) 2019 Andrew Fernandes <andrew@fernandes.org>
#
# SPDX-License-Identifier: Apache-2.0
#

CONFIG_ARM=y
CONFIG_ARM_MPU=y

CONFIG_SOC_FAMILY_NRF=y
CONFIG_SOC_SERIES_NRF52X=y
CONFIG_SOC_NRF52832_CIAA=y

CONFIG_BOARD_NRF52832_MIDAIR=y

CONFIG_CLOCK_CONTROL_NRF_K32SRC_RC=n
CONFIG_CLOCK_CONTROL_NRF_K32SRC_XTAL=y
CONFIG_CLOCK_CONTROL_NRF_K32SRC_50PPM=y # From the ISP1507 Data Sheet

CONFIG_GPIO_AS_PINRESET=y
CONFIG_NFCT_PINS_AS_GPIOS=y

CONFIG_GPIO=y
CONFIG_NRFX_GPIOTE=y

CONFIG_NRFX_PPI=y
CONFIG_NRFX_SYSTICK=y

CONFIG_ADC=y
CONFIG_ADC_ASYNC=y
CONFIG_ADC_0=y

CONFIG_PWM=y
CONFIG_PWM_0=y
CONFIG_PWM_1=y
CONFIG_PWM_2=y

CONFIG_SPI=y
CONFIG_SPI_ASYNC=y
CONFIG_SPI_0=y
CONFIG_SPI_0_NRF_SPIM=y
CONFIG_SOC_NRF52832_ALLOW_SPIM_DESPITE_PAN_58=y

CONFIG_I2C=y
#|CONFIG_I2C_ASYNC=y
CONFIG_I2C_1=y
CONFIG_I2C_1_NRF_TWIM=y

CONFIG_ENTROPY_GENERATOR=y
CONFIG_ENTROPY_DEVICE_RANDOM_GENERATOR=y

# Nordic RTC1 is used for the system clock
# Nordic RTC0   may be reserved for Bluetooth
# Nordic TIMER0 may be reserved for Bluetooth
#
CONFIG_COUNTER=y
CONFIG_COUNTER_RTC2=y
CONFIG_COUNTER_TIMER1=y
CONFIG_COUNTER_TIMER2=y
CONFIG_COUNTER_TIMER3=y
CONFIG_COUNTER_TIMER4=y
```

## midair/boards/arm/midair_yy4geij/Kconfig
```kconfig
# midair-yy4geij configuration
#
# Copyright (c) 2020 Andrew Fernandes <andrew@fernandes.org>
# SPDX-License-Identifier: Apache-2.0

config BOARD_ENABLE_DCDC
    bool "Enable DCDC mode"
    select SOC_DCDC_NRF52X
    default y
    depends on BOARD_MIDAIR_YY4GEIJ
```

## midair/boards/arm/midair_yy4geij/Kconfig.board
```kconfig
# midair-yy4geij configuration
#
# Copyright (c) 2020 Andrew Fernandes <andrew@fernandes.org>
# SPDX-License-Identifier: Apache-2.0

config BOARD_MIDAIR_YY4GEIJ
	bool "nRF52832 midair"
	depends on SOC_NRF52832_CIAA
```

## midair/boards/arm/midair_yy4geij/Kconfig.defconfig
```kconfig
# midair-yy4geij configuration
#
# Copyright (c) 2020 Andrew Fernandes <andrew@fernandes.org>
# SPDX-License-Identifier: Apache-2.0

if BOARD_MIDAIR_YY4GEIJ

config BOARD
	default "midair_yy4geij"

config HAS_STMEMSC
       default y

config USE_STDC_LSM6DSOX
       default y

endif # BOARD_MIDAIR_YY4GEIJ
```

## midair/boards/arm/nrf52832_midair/dts/bindings/lsm6dsox.yaml
```yaml
# Copyright (c) 2020 Andrew Fernandes <andrew@fernandes.org>
# SPDX-License-Identifier: Apache-2.0

description: |
  STMicroelectronics LSM6DSOX 6-axis IMU (Inertial Measurement Unit)
  sensor accessed through SPI bus

compatible: "lsm6dsox"

include: spi-device.yaml

properties:

  int1-gpios:
    type: phandle-array
    required: false
    description: INT1 pin
      This pin defaults to active high when produced by the sensor.
      The property value should ensure the flags properly describe
      the signal that is presented to the driver.

  int2-gpios:
    type: phandle-array
    required: false
    description: INT2 pin
      This pin defaults to active high when produced by the sensor.
      The property value should ensure the flags properly describe
      the signal that is presented to the driver.
```

## midair/boards/arm/nrf52832_midair/nrf52832_midair_defconfig
```kconfig
# nrf52832-midair configuration
#
# Copyright (c) 2020 Andrew Fernandes <andrew@fernandes.org>
# SPDX-License-Identifier: Apache-2.0

CONFIG_SOC_SERIES_NRF52X=y
CONFIG_SOC_NRF52832_CIAA=y
CONFIG_BOARD_NRF52832_MIDAIR=y

CONFIG_ARM_MPU=y

CONFIG_CLOCK_CONTROL_NRF_K32SRC_RC=n
CONFIG_CLOCK_CONTROL_NRF_K32SRC_XTAL=y
CONFIG_CLOCK_CONTROL_NRF_K32SRC_50PPM=y # From the ISP1507 Data Sheet

CONFIG_GPIO_AS_PINRESET=y
CONFIG_NFCT_PINS_AS_GPIOS=y

CONFIG_GPIO=y
CONFIG_NRFX_GPIOTE=y

CONFIG_NRFX_PPI=y
CONFIG_NRFX_SYSTICK=y

CONFIG_ADC=y
CONFIG_ADC_0=y

CONFIG_PWM=y
CONFIG_PWM_0=y
CONFIG_PWM_1=y
CONFIG_PWM_2=y

CONFIG_SPI=y
CONFIG_SPI_0=y
CONFIG_NRFX_SPIM0=y
CONFIG_SOC_NRF52832_ALLOW_SPIM_DESPITE_PAN_58=y

CONFIG_I2C=y
CONFIG_I2C_1=y
CONFIG_NRFX_TWIM1=y

CONFIG_POLL=y
CONFIG_ADC_ASYNC=y
CONFIG_SPI_ASYNC=y
#|CONFIG_I2C_ASYNC=y # Doesn't exist in zephyr-v2.2.0-1666-gf3b4d8a86f

CONFIG_ENTROPY_GENERATOR=y
CONFIG_ENTROPY_DEVICE_RANDOM_GENERATOR=y

# Nordic RTC1 is used for the system clock
# Nordic RTC0   may be reserved for Bluetooth
# Nordic TIMER0 may be reserved for Bluetooth
#
CONFIG_COUNTER=y
CONFIG_COUNTER_RTC2=y
CONFIG_COUNTER_TIMER1=y
CONFIG_COUNTER_TIMER2=y
CONFIG_COUNTER_TIMER3=y
CONFIG_COUNTER_TIMER4=y
```
