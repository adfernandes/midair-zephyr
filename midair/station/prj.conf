## CMakeLists.txt
```
# midair station configuration
#
# Copyright (c) 2020 Andrew Fernandes <andrew@fernandes.org>
# SPDX-License-Identifier: Apache-2.0

cmake_minimum_required(VERSION "$ENV{CMAKE_MINIMUM_REQUIRED}")

# -----------------------------------------------------------------------------

# We might use a custom board
#
set(BOARD "nrf52840dongle_nrf52840")
#
set(BOARD_ROOT "$ENV{PROJECT_DIR}/midair")

# The C++ Standard version is set in 'prj.conf' via the 'CONFIG_STD_CPP17' setting
#
set_property(GLOBAL PROPERTY CSTD "gnu17") # https://gcc.gnu.org/onlinedocs/gcc/Standards.html

# https://docs.zephyrproject.org/latest/guides/modules.html#without-west
#
# See the list of current modules in "$ENV{PROJECT_DIR}/zephyr/west.yml"
#
set(ZEPHYR_MODULES
    "$ENV{PROJECT_DIR}/modules/cmsis"
    "$ENV{PROJECT_DIR}/modules/nordic"
    "$ENV{PROJECT_DIR}/modules/segger"
)
#
include("$ENV{ZEPHYR_BASE}/cmake/app/boilerplate.cmake" NO_POLICY_SCOPE)

# -----------------------------------------------------------------------------

project(station)

include_directories(
    "src"
)

set(C_SOURCES
    "src/main.c"
    "board/${BOARD}.c"
)

target_sources(app PRIVATE ${C_SOURCES})

# -----------------------------------------------------------------------------
# Done
```

## prj.conf
```kconfig
# midair station configuration
#
# Copyright (c) 2020 Andrew Fernandes <andrew@fernandes.org>
# SPDX-License-Identifier: Apache-2.0

CONFIG_ASSERT=y
CONFIG_ASSERT_LEVEL=2
CONFIG_ASSERT_VERBOSE=y

CONFIG_DEBUG_INFO=y
CONFIG_DEBUG_OPTIMIZATIONS=y
CONFIG_SPEED_OPTIMIZATIONS=n
CONFIG_SIZE_OPTIMIZATIONS=n

CONFIG_BOOTLOADER_MCUBOOT=n
CONFIG_BOARD_HAS_NRF5_BOOTLOADER=n

CONFIG_OUTPUT_STAT=y
CONFIG_OUTPUT_DISASSEMBLY=y
CONFIG_OUTPUT_PRINT_MEMORY_USAGE=y

CONFIG_LOG=y
CONFIG_LOG_PRINTK=y
CONFIG_LOG_BACKEND_SHOW_COLOR=n
CONFIG_LOG_BUFFER_SIZE=2048
CONFIG_LOG_STRDUP_MAX_STRING=256
CONFIG_LOG_PRINTK_MAX_STRING_LENGTH=256
CONFIG_LOG_PROCESS_THREAD_SLEEP_MS=100

CONFIG_CONSOLE=y
CONFIG_RTT_CONSOLE=y

CONFIG_USE_SEGGER_RTT=y

CONFIG_SEGGER_RTT_BUFFER_SIZE_UP=2048
CONFIG_SEGGER_RTT_PRINTF_BUFFER_SIZE=256

CONFIG_MAIN_STACK_SIZE=2048
CONFIG_SYSTEM_WORKQUEUE_STACK_SIZE=4096

CONFIG_TICKLESS_IDLE=y
CONFIG_SYS_PM_STATE_LOCK=y
CONFIG_SYS_POWER_MANAGEMENT=y
CONFIG_SYS_POWER_DEEP_SLEEP_STATES=y
CONFIG_DEVICE_POWER_MANAGEMENT=y
CONFIG_DEVICE_IDLE_PM=y

CONFIG_CPLUSPLUS=y
CONFIG_STD_CPP17=y
CONFIG_NEWLIB_LIBC=y
CONFIG_LIB_CPLUSPLUS=y
CONFIG_EXCEPTIONS=n
CONFIG_RTTI=n

CONFIG_FPU=y
CONFIG_FPU_SHARING=y
CONFIG_NEWLIB_LIBC_FLOAT_PRINTF=y
CONFIG_NEWLIB_LIBC_FLOAT_SCANF=y

CONFIG_PWM=y
```

## src/main.c
```c
/*
 * Copyright (c) 2016 Intel Corporation
 * Copyright (c) 2020 Nordic Semiconductor ASA
 *
 * SPDX-License-Identifier: Apache-2.0
 */

/**
 * @file Sample app to demonstrate PWM-based LED fade
 */

#include <zephyr.h>
#include <sys/printk.h>
#include <device.h>
#include <drivers/pwm.h>

#define PWM_LED0_NODE	DT_ALIAS(pwm_led0)

/*
 * Devicetree helper macro which gets the 'flags' cell from the node's
 * pwms property, or returns 0 if the property has no 'flags' cell.
 */

#define FLAGS_OR_ZERO(node)						\
	COND_CODE_1(DT_PHA_HAS_CELL(node, pwms, flags),		\
		    (DT_PWMS_FLAGS(node)),				\
		    (0))

#if DT_NODE_HAS_STATUS(PWM_LED0_NODE, okay)
#define PWM_LABEL	DT_PWMS_LABEL(PWM_LED0_NODE)
#define PWM_CHANNEL	DT_PWMS_CHANNEL(PWM_LED0_NODE)
#define PWM_FLAGS	FLAGS_OR_ZERO(PWM_LED0_NODE)
#else
#error "Unsupported board: pwm-led0 devicetree alias is not defined"
#define PWM_LABEL	""
#define PWM_CHANNEL	0
#define PWM_FLAGS	0
#endif

/*
 * This period should be fast enough to be above the flicker fusion
 * threshold. The steps should also be small enough, and happen
 * quickly enough, to make the output fade change appear continuous.
 */
#define PERIOD_USEC	20000U
#define NUM_STEPS	50U
#define STEP_USEC	(PERIOD_USEC / NUM_STEPS)
#define SLEEP_MSEC	25U

void main(void)
{
    struct device *pwm;
    uint32_t pulse_width = 0U;
    uint8_t dir = 1U;
    int ret;

    printk("PWM-based LED fade\n");

    pwm = device_get_binding(PWM_LABEL);
    if (!pwm) {
        printk("Error: didn't find %s device\n", PWM_LABEL);
        return;
    }

    while (1) {
        ret = pwm_pin_set_usec(pwm, PWM_CHANNEL, PERIOD_USEC,
                               pulse_width, PWM_FLAGS);
        if (ret) {
            printk("Error %d: failed to set pulse width\n", ret);
            return;
        }

        if (dir) {
            pulse_width += STEP_USEC;
            if (pulse_width >= PERIOD_USEC) {
                pulse_width = PERIOD_USEC - STEP_USEC;
                dir = 0U;
            }
        } else {
            if (pulse_width >= STEP_USEC) {
                pulse_width -= STEP_USEC;
            } else {
                pulse_width = STEP_USEC;
                dir = 1U;
            }
        }

        k_sleep(K_MSEC(SLEEP_MSEC));
    }
}
```
