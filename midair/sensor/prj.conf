## CMakeLists.txt
```
# midair sensor configuration
#
# Copyright (c) 2020 Andrew Fernandes <andrew@fernandes.org>
# SPDX-License-Identifier: Apache-2.0

cmake_minimum_required(VERSION "$ENV{CMAKE_MINIMUM_REQUIRED}")

# -----------------------------------------------------------------------------

# We might use a custom board
#
set(BOARD "midair_yy4geij")
#
set(BOARD_ROOT "$ENV{PROJECT_DIR}/midair")

# The C++ Standard version is set in 'prj.conf' via the 'CONFIG_STD_CPP17' setting
#
set_property(GLOBAL PROPERTY CSTD "gnu17") # https://gcc.gnu.org/onlinedocs/gcc/Standards.html

# https://docs.zephyrproject.org/latest/guides/modules.html#without-west
#
# See the list of current modules in "$ENV{PROJECT_DIR}/zephyr/west.yml"
#
set(ZEPHYR_MODULES
    "$ENV{PROJECT_DIR}/modules/cmsis"
    "$ENV{PROJECT_DIR}/modules/nordic"
    "$ENV{PROJECT_DIR}/modules/segger"
    "$ENV{PROJECT_DIR}/modules/stmemsc"
)
#
include("$ENV{ZEPHYR_BASE}/cmake/app/boilerplate.cmake" NO_POLICY_SCOPE)

# -----------------------------------------------------------------------------

project(sensor)

include_directories(
    "src"
    "src/dev"
    "src/ble"
)

set(CXX_SOURCES
    "src/new.cpp"
    "src/main.cpp"
    "src/dev/devices.cpp"
    "src/dev/leds.cpp"
    "src/dev/buttons.cpp"
    "src/dev/battery.cpp"
    "src/dev/lsm6dsox.cpp"
    "src/dev/mmc5883ma.cpp"
)

target_sources(app PRIVATE ${CXX_SOURCES})

# -----------------------------------------------------------------------------
# Done
```

## prj.conf
```kconfig
# midair sensor configuration
#
# Copyright (c) 2020 Andrew Fernandes <andrew@fernandes.org>
# SPDX-License-Identifier: Apache-2.0

CONFIG_ASSERT=y
CONFIG_ASSERT_LEVEL=2
CONFIG_ASSERT_VERBOSE=y

CONFIG_DEBUG_INFO=y
CONFIG_DEBUG_OPTIMIZATIONS=y
CONFIG_SPEED_OPTIMIZATIONS=n
CONFIG_SIZE_OPTIMIZATIONS=n

CONFIG_BOOTLOADER_MCUBOOT=n
CONFIG_USE_DT_CODE_PARTITION=y

CONFIG_OUTPUT_STAT=y
CONFIG_OUTPUT_DISASSEMBLY=y
CONFIG_OUTPUT_PRINT_MEMORY_USAGE=y

CONFIG_LOG=y
CONFIG_LOG_PRINTK=y
CONFIG_LOG_BACKEND_SHOW_COLOR=n
CONFIG_LOG_BUFFER_SIZE=2048
CONFIG_LOG_STRDUP_MAX_STRING=256
CONFIG_LOG_PRINTK_MAX_STRING_LENGTH=256
CONFIG_LOG_PROCESS_THREAD_SLEEP_MS=100

CONFIG_CONSOLE=y
CONFIG_RTT_CONSOLE=y

CONFIG_USE_SEGGER_RTT=y

CONFIG_SEGGER_RTT_BUFFER_SIZE_UP=2048
CONFIG_SEGGER_RTT_PRINTF_BUFFER_SIZE=256

CONFIG_MAIN_STACK_SIZE=2048
CONFIG_SYSTEM_WORKQUEUE_STACK_SIZE=4096

CONFIG_TICKLESS_IDLE=y
CONFIG_SYS_PM_STATE_LOCK=y
CONFIG_SYS_POWER_MANAGEMENT=y
CONFIG_SYS_POWER_DEEP_SLEEP_STATES=y
CONFIG_DEVICE_POWER_MANAGEMENT=y
CONFIG_DEVICE_IDLE_PM=y

CONFIG_CPLUSPLUS=y
CONFIG_STD_CPP17=y
CONFIG_NEWLIB_LIBC=y
CONFIG_LIB_CPLUSPLUS=y
CONFIG_EXCEPTIONS=n
CONFIG_RTTI=n

CONFIG_FPU=y
CONFIG_FPU_SHARING=y
CONFIG_NEWLIB_LIBC_FLOAT_PRINTF=y
CONFIG_NEWLIB_LIBC_FLOAT_SCANF=y

#|CONFIG_BT=y
#|CONFIG_BT_DEBUG_LOG=n
#|#
#|#|CONFIG_BT_SMP=y
#|CONFIG_BT_CENTRAL=y
#|CONFIG_BT_GATT_CLIENT=y
#|CONFIG_BT_PERIPHERAL=y
#|#
#|CONFIG_BT_ATT_PREPARE_COUNT=5
#|CONFIG_BT_GAP_PERIPHERAL_PREF_PARAMS=y
#|CONFIG_BT_PERIPHERAL_PREF_MIN_INT=6
#|CONFIG_BT_PERIPHERAL_PREF_MAX_INT=12
#|CONFIG_BT_PERIPHERAL_PREF_SLAVE_LATENCY=0
#|CONFIG_BT_PERIPHERAL_PREF_TIMEOUT=200
#|#
#|CONFIG_BT_RX_BUF_LEN=258
#|CONFIG_BT_CTLR_TX_BUFFER_SIZE=251
#|CONFIG_BT_CTLR_DATA_LENGTH_MAX=251
#|#
#|CONFIG_BT_CTLR_CHAN_SEL_2=y
#|#
#|CONFIG_BT_GATT_DIS=y
#|CONFIG_BT_GATT_DIS_PNP=n
#|CONFIG_BT_DEVICE_NAME="midair"
#|#
#|CONFIG_BT_LL_SW_SPLIT=y
```

## src/main.cpp
```c
#include "main.hpp"
#include "devices.hpp"

#include "leds.hpp"
#include "buttons.hpp"
#include "battery.hpp"

#include "lsm6dsox.hpp"
#include "mmc5883ma.hpp"

LOG_MODULE_REGISTER(midair, LOG_LEVEL_DBG);

//----------------------------------------------------------------------
//
#if defined(__clang__)
#pragma clang diagnostic push
#pragma clang diagnostic ignored "-Wmissing-noreturn"
#endif // !defined(__clang__)
//
void main(void) {

    devices_init();

    configure_leds();
    configure_buttons();
    configure_lsm6dsox();
    configure_mmc5883ma();
    configure_battery();

    unsigned foo = 1;
    __ASSERT(foo == 0xF0CACC1A, "Invalid value of foo, got 0x%x", foo);

    insist(counter_start(dev.rtc2));

    while (true) {

        const bool red_pushed = get_red_btn_state();
        const bool grn_pushed = get_grn_btn_state();

        uint32_t counter_value;
        insist(counter_get_value(dev.rtc2, &counter_value));
        const float seconds = rtc2_rate * counter_value;
        const float radians = 3.14159265358979323846f * seconds;

        uint8_t red_bright = uint8_t(lroundf(255.0f * (0.5f * (sin(radians) + 1.0f))));
        uint8_t grn_bright = UINT8_MAX - red_bright;

        set_red_led_state(red_bright | (red_pushed ? 0x80 : 0x00));
        set_grn_led_state(grn_bright | (grn_pushed ? 0x80 : 0x00));

        if (!isfinite(seconds)) break; // no 'endless loop' warning

        k_msleep(32);

    }

}
//
#if defined(__clang__)
#pragma clang diagnostic pop
#endif // !defined(__clang__)
//
//----------------------------------------------------------------------
```

## src/insist.h
```c
#pragma once

#include <zephyr.h>

#include <logging/log.h>
#include <logging/log_ctrl.h>

//----------------------------------------------------------------------
// Static assertions, for C and C++ both

#ifdef __cplusplus
#ifndef _Static_assert
        #define _Static_assert static_assert
    #endif // _Static_assert
#endif // __cplusplus

#define STATIC_ASSERT(is_true) _Static_assert((is_true), #is_true )

//----------------------------------------------------------------------
// User threads are not allowed to induce kernel panics, use an 'oops' instead
//
// Also, CLion does not understand https://gcc.gnu.org/onlinedocs/cpp/Variadic-Macros.html
// so use '##__VA_ARGS__' rather than the more modern '__VA_OPT__(,) __VA_ARGS__' style

#define sys_panic(message, ...) {               \
        LOG_PANIC();                            \
        LOG_ERR(message, ##__VA_ARGS__);        \
        assert_post_action(__FILE__, __LINE__); \
    }

//----------------------------------------------------------------------
// A helper function for something that we do a lot, note that
// STRINGIFY is defined in 'zephyr/include/toolchain/common.h'

#define insist(function) do {                                                                \
    const int failed = (function);                                                           \
    if (unlikely(failed)) {                                                                  \
        sys_panic("failed '" STRINGIFY(function) "' at " __FILE__  ":" STRINGIFY(__LINE__)); \
    }                                                                                        \
} while (false)

#define insist_that(failed) insist(!(failed))

//----------------------------------------------------------------------
```

## src/main.hpp
```c
#pragma once

//----------------------------------------------------------------------
// Core include files

#include <zephyr.h>

#include <device.h>
#include <devicetree_legacy_unfixed.h> // FIXME Remove me!



#include <power/power.h>

#include <drivers/counter.h>
#include <drivers/gpio.h>
#include <drivers/spi.h>
#include <drivers/i2c.h>
#include <drivers/pwm.h>

#ifdef CONFIG_BT
#include "ble.hpp"
#endif

//----------------------------------------------------------------------
// Nordic specific drivers and HAL subsystems

#include <nrfx.h>

#include <nrfx_ppi.h>
#include <nrfx_gpiote.h>
#include <nrfx_saadc.h>

#include <nrfx/hal/nrf_ficr.h>
#include <nrfx/hal/nrf_clock.h>
#include <nrfx/hal/nrf_radio.h>
#include <nrfx/hal/nrf_systick.h>

#include <lsm6dsox_reg.h>

//----------------------------------------------------------------------
// Standard C and C++ headers

#include <stdint.h>
#include <stdlib.h>
#include <math.h>

#include <algorithm>
#include <type_traits>
#include <array>
#include <new>

using namespace std;

//----------------------------------------------------------------------
// Static and dynamic assertion and verification macros and functions

#include "insist.h"  // valid for C and C++ both
#include "utility.h" // valid for C and C++ both

//----------------------------------------------------------------------
// These 'include' directives are NOT needed by Zephyr.
//
// They are only included so that Visual Studio Code's
// "vscode-cpptools" intellisense can work properly.

#if defined(VSCODE_CPPTOOLS_INTELLISENSE)
#include "zephyr/include/generated/autoconf.h"
#include "zephyr/soc/arm/nordic_nrf/nrf52/dts_fixup.h"
#include "zephyr/include/generated/generated_dts_board_unfixed.h"
#define  k_panic() // this expands properly during compilation
#define  k_oops()  // this expands properly during compilation
#endif

//----------------------------------------------------------------------
```

## src/new.cpp
```c
#include "main.hpp"

void * operator new (size_t count) {
    
}

void operator delete (void *ptr) noexcept {

}
```

## src/utility.h
```c
#pragma once

//----------------------------------------------------------------------

extern "C" char *gcvtf(float, int, char *); // newlib: float -> string

//----------------------------------------------------------------------

#define DEVICE_GET_BINDING(port, name)   \
    (port) = device_get_binding((name)); \
    if (unlikely((port) == NULL)) {                             \
        sys_panic("device_get_binding(\"%s\") failed", (name)); \
    }

//----------------------------------------------------------------------
#ifdef __cplusplus

// A C++14 safe way of casting an 'enum class' to it's underlying type,
// see https://stackoverflow.com/a/33083231/1229371 for details

#include <type_traits>

template <typename E>
constexpr auto to_underlying(E e) noexcept;

template<typename E>
constexpr auto to_underlying(E e) noexcept
{
    return static_cast<std::underlying_type_t<E>>(e);
}

#endif // ! __cplusplus
//----------------------------------------------------------------------
```
